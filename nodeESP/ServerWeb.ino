#include <ESP8266WiFi.h>
#include <WiFiClient.h>
#include <ESP8266WebServer.h>
#include <ESP8266mDNS.h>

const char *ssid = "MOVISTAR_362C";
const char *password = "KYRRK3FRTUM94ETENXNN";

ESP8266WebServer server ( 80 );

const int LED_ROJO = 15;
const int LED_AZUL = 12;
const int LED_VERDE = 13;

const char index_html[] = {0x3C,0x21,0x44,0x4F,0x43,0x54,0x59,0x50,0x45,0x20,0x68,0x74,0x6D,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0x6C,0x3E};
const char index1_html[] PROGMEM = {0x3C,0x21,0x44,0x4F,0x43,0x54,0x59,0x50,0x45,0x20,0x68,0x74,0x6D,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0x6C,0x3E};



void handleRoot() 
{
  digitalWrite ( LED_ROJO, 1 );
  char temp[400];
  int sec = millis() / 1000;
  int min = sec / 60;
  int hr = min / 60;

  snprintf ( temp, 400,

"<html>\
  <head>\
    <meta http-equiv='refresh' content='5'/>\
    <title>ESP8266 Demo</title>\
    <style>\
      body { background-color: #cccccc; font-family: Arial, Helvetica, Sans-Serif; Color: #000088; }\
    </style>\
  </head>\
  <body>\
    <h1>Hello from ESP8266!</h1>\
    <p>Uptime: %02d:%02d:%02d</p>\
    <img src=\"/test.svg\" />\
  </body>\
</html>",

    hr, min % 60, sec % 60
  );
  server.send ( 200, "text/html", temp );
  digitalWrite ( LED_ROJO, 0 );
}

void handleNotFound() 
{
  digitalWrite ( LED_ROJO, 1 );
  String message = "File Not Found\n\n";
  message += "URI: ";
  message += server.uri();
  message += "\nMethod: ";
  message += ( server.method() == HTTP_GET ) ? "GET" : "POST";
  message += "\nArguments: ";
  message += server.args();
  message += "\n";

  for ( uint8_t i = 0; i < server.args(); i++ ) {
    message += " " + server.argName ( i ) + ": " + server.arg ( i ) + "\n";
  }

  server.send ( 404, "text/plain", message );
  digitalWrite ( LED_ROJO, 0 );
}

void setup ( void ) 
{
  pinMode ( LED_ROJO, OUTPUT );
  pinMode ( LED_VERDE, OUTPUT );
  pinMode ( LED_AZUL, OUTPUT );
  digitalWrite ( LED_ROJO, 0 );
  digitalWrite ( LED_VERDE, 0 );
  digitalWrite ( LED_AZUL, 0 );
  
  Serial.begin ( 115200 );
  WiFi.mode ( WIFI_STA );
  WiFi.begin ( ssid, password );
  Serial.println ( "" );

  // Wait for connection
  while ( WiFi.status() != WL_CONNECTED ) 
  {
    delay ( 500 );
    Serial.print ( "." );
  }

  Serial.println ( "" );
  Serial.print ( "Connected to " );
  Serial.println ( ssid );
  Serial.print ( "IP address: " );
  Serial.println ( WiFi.localIP() );

  if ( MDNS.begin ( "esp8266" ) ) 
  {
    Serial.println ( "MDNS responder started" );
  }

  server.on ( "/", handleRoot );
  server.on ( "/test.svg", drawGraph );
  server.on ( "/inline", []() 
  {
    server.send ( 200, "text/plain", "this works as well" );
  } );
  
  server.on("/pepe.html",[]()
  {
    server.send(200,"text/html",index_html);
  });

  server.on("/index1.html",[]()
  {
    digitalWrite ( LED_VERDE, 1 );
    server.send_P(200, "text/html", index1_html, sizeof(index1_html));
    digitalWrite ( LED_VERDE, 0 );
  });

  server.on("/api",HTTP_POST,[]()
  {
    char bff[1024];
    digitalWrite ( LED_AZUL, 1 );
    if (server.args() > 0)
    {
      for (int i = 0; i < server.args();i++)
      {
        Serial.print("POST Arguments: " ); Serial.println(i);
        Serial.print("Name: "); Serial.println(server.argName(i));
        Serial.print("Value: "); Serial.println(server.arg(i));
      }
    }
    sprintf(bff,"12,444,hola mundo, dos tres ...,,caca,");
    server.send(200,"text/plain",bff);
    digitalWrite ( LED_AZUL, 0 );
  });

  server.on("/api2",[]()
  {
        if (server.method() == HTTP_POST)
        {
          String message = "POST\nHeaders:\n";
          for (uint8_t i = 0; i < server.headers(); i++)
          {
              message += server.headerName(i) + ": " + server.header(i) + "\n";
          }
          message += "\nRequest params:\n";
          for (uint8_t i = 0; i < server.args(); i++){
              message += " " + server.argName(i) + ": " + server.arg(i) + "\n";
          }
          server.send(200, "text/plain", message);
        }
        else
        {
          server.send(200, "text/plain", "1");
        }
  });
  
  server.onNotFound ( handleNotFound );
  server.begin();
  Serial.println ( "HTTP server started" );
}

void loop ( void ) 
{
  server.handleClient();
}

void drawGraph() 
{
  String out = "";
  char temp[100];
  out += "<svg xmlns=\"http://www.w3.org/2000/svg\" version=\"1.1\" width=\"400\" height=\"150\">\n";
  out += "<rect width=\"400\" height=\"150\" fill=\"rgb(250, 230, 210)\" stroke-width=\"1\" stroke=\"rgb(0, 0, 0)\" />\n";
  out += "<g stroke=\"black\">\n";
  int y = rand() % 130;
  for (int x = 10; x < 390; x+= 10) {
    int y2 = rand() % 130;
    sprintf(temp, "<line x1=\"%d\" y1=\"%d\" x2=\"%d\" y2=\"%d\" stroke-width=\"1\" />\n", x, 140 - y, x + 10, 140 - y2);
    out += temp;
    y = y2;
  }
  out += "</g>\n</svg>\n";

  server.send ( 200, "image/svg+xml", out);
}


